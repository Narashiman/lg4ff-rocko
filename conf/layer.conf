## conf/layer.conf
```bitbake
# meta-g239-drivers layer configuration
BBPATH .= ":${LAYERDIR}"
BBFILES += "${LAYERDIR}/recipes-*/*/*.bb ${LAYERDIR}/recipes-*/*/*.bbappend"
LAYERSERIES_COMPAT_g239-drivers = "rocko dunfell kirkstone warrior"
```
